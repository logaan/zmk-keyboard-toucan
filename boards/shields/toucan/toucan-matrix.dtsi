// Only the keyboard halves scan GPIOs. The dongle shares toucan.dtsi's layout
// and input processing, but must leave these pins free for the Prospector.

// Matrix columns use the nRF52840 NFC pins P0.09/P0.10. Zephyr 4.1 moves
// this setup from the old NFCT_PINS_AS_GPIOS Kconfig symbol to devicetree.
&uicr {
    nfct-pins-as-gpios;
};

/ {
    chosen {
        zmk,kscan = &kscan0;
    };

    kscan0: kscan_0 {
        compatible = "zmk,kscan-gpio-matrix";
        diode-direction = "col2row";
        wakeup-source;
        row-gpios = <&gpio0 19 (GPIO_ACTIVE_HIGH | GPIO_PULL_DOWN)>,
                    <&gpio0 28 (GPIO_ACTIVE_HIGH | GPIO_PULL_DOWN)>,
                    <&gpio1 1 (GPIO_ACTIVE_HIGH | GPIO_PULL_DOWN)>,
                    <&gpio0 29 (GPIO_ACTIVE_HIGH | GPIO_PULL_DOWN)>;
    };
};
