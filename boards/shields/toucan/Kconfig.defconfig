## boards/shields/toucan/Kconfig.defconfig
```kconfig
if SHIELD_TOUCAN_DONGLE

config ZMK_KEYBOARD_NAME
    default "Toucan"

config ZMK_SPLIT_ROLE_CENTRAL
    default y

# Two keyboard halves plus the usual five host profiles.
config ZMK_SPLIT_BLE_CENTRAL_PERIPHERALS
    default 2

config BT_MAX_CONN
    default 7

config BT_MAX_PAIRED
    default 7

config ZMK_SPLIT_BLE_CENTRAL_BATTERY_LEVEL_FETCHING
    default y

config ZMK_SPLIT_BLE_CENTRAL_BATTERY_LEVEL_PROXY
    default y

endif

if SHIELD_TOUCAN_LEFT

config ZMK_KEYBOARD_NAME
    default "Toucan"

config ZMK_SPLIT_ROLE_CENTRAL
    default y

config ZMK_SPLIT_BLE_CENTRAL_BATTERY_LEVEL_FETCHING
    default y

config ZMK_SPLIT_BLE_CENTRAL_BATTERY_LEVEL_PROXY
    default y

endif



if SHIELD_TOUCAN_LEFT || SHIELD_TOUCAN_LEFT_PERIPHERAL || SHIELD_TOUCAN_RIGHT || SHIELD_TOUCAN_DONGLE

config SPI
    default y if SHIELD_TOUCAN_LEFT || SHIELD_TOUCAN_LEFT_PERIPHERAL

config ZMK_SPLIT
    default y

config ZMK_POINTING
    default y

config RGBLED_WIDGET_BATTERY_LEVEL_HIGH
    default 40

endif
```

## boards/shields/toucan_braille_ui/Kconfig.defconfig
```kconfig
if SHIELD_TOUCAN_BRAILLE_UI

choice PROSPECTOR_STATUS_SCREEN_LAYOUT
    default PROSPECTOR_STATUS_SCREEN_BRAILLE

config PROSPECTOR_STATUS_SCREEN_BRAILLE
    bool "Toucan braille dashboard"
    select LV_USE_LABEL
    select LV_FONT_MONTSERRAT_14
    select LV_FONT_MONTSERRAT_20
    select LV_FONT_MONTSERRAT_28

endchoice

config TOUCAN_BRAILLE_UI_LAYER
    int "Braille keymap layer index"
    default 5

endif
```

## boards/shields/toucan_braille_ui/Kconfig.shield
```kconfig
config SHIELD_TOUCAN_BRAILLE_UI
    def_bool $(shields_list_contains,toucan_braille_ui)
```
